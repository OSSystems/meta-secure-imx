## conf/layer.conf
```bitbake
# We have a conf and classes directory, append to BBPATH
BBPATH .= ":${LAYERDIR}"

# We have a recipes directory, add to BBFILES
BBFILES += "${LAYERDIR}/recipes*/*/*.bb ${LAYERDIR}/recipes*/*/*.bbappend"

BBFILE_COLLECTIONS += "secure-imx"
BBFILE_PATTERN_secure-imx := "^${LAYERDIR}/"
BBFILE_PRIORITY_secure-imx = "10"

LICENSE_PATH += "${LAYERDIR}/licenses"
SECURE_BASE := '${LAYERDIR}'

# Layer dependencies
LAYERSERIES_COMPAT_secure-imx = "dunfell"
LAYERDEPENDS_secure-imx = "core openembedded-layer"

# The dynamic-layers directory hosts the extensions and layer specific
# modifications.
#
# The .bbappend and .bb files are included if the respective layer
# collection is available.
BBFILES += "${@' '.join('${LAYERDIR}/dynamic-layers/%s/recipes*/*/*.bbappend' % layer \
               for layer in BBFILE_COLLECTIONS.split())}"
BBFILES += "${@' '.join('${LAYERDIR}/dynamic-layers/%s/recipes*/*/*.bb' % layer \
               for layer in BBFILE_COLLECTIONS.split())}"

BBFILES_DYNAMIC += " \
    security:${LAYERDIR}/dynamic-layers/security/*/*/*.bb \
"
```

## conf/machine/include/crypt.inc
```bitbake
# data volume settings
DATA_VOL ?= "/opt/data"
OFS_DIR ?= "${DATA_VOL}/overlayfs"

SIGN_KEY ?= "${SECURE_BASE}/conf/keys/fs_prime256v1_key.pem"
SIGN_KEY_PUB ?= "${SECURE_BASE}/conf/keys/fs_prime256v1_pub_key.pem"

ENC_KEY_RAW ?= "fdf6842566d47e47d6874da561fec433"

INITRAMFS_IMAGE ?= "crypt-image-initramfs"

IMAGE_FSTYPES = "squashfs-lz4.crypt ext4.crypt ext4.gz.crypt"
IMAGE_CLASSES += "crypt-fs"
```

## conf/machine/include/hab.inc
```bitbake
# HAB Settings
HAB_ENABLE = "1"
HAB_DIR ?= "${SECURE_BASE}/conf/hab"
SRKTAB ?= "${HAB_DIR}/crts/SRK_1_2_3_4_table.bin"
CSFK ?= "${HAB_DIR}/crts/CSF1_1_sha256_secp521r1_v3_usr_crt.pem"
SIGN_CERT ?= "${HAB_DIR}/crts/IMG1_1_sha256_secp521r1_v3_usr_crt.pem"

# u-boot
UBOOT_NAME = "u-boot-ivt"
UBOOT_SIGN_SUFFIX = "signed"
UBOOT_BINARY = "${UBOOT_NAME}.${UBOOT_SUFFIX}"

# kernel
KERNEL_SIGN_SUFFIX = "signed"
KERNEL_CLASSES += "fitimage-hab-sign swupdate-encrypt"
IMAGE_BOOT_FILES = "fitImage-${INITRAMFS_IMAGE}-${MACHINE}.bin.${KERNEL_SIGN_SUFFIX};fitImage"
```

## conf/machine/include/swu.inc
```bitbake
## SWUPDATE sign configuration
#Sign with RSA
SWUPDATE_SIGNING  = "RSA"
SWUPDATE_PRIVATE_KEY = "${SECURE_BASE}/conf/keys/swu_rsa_key.pem"
SWUPDATE_PUBLIC_KEY = "${SECURE_BASE}/conf/keys/swu_rsa_pub_key.pem"
SWUPDATE_PASSWORD_FILE = "${SECURE_BASE}/conf/keys/passphrase"
SWU_KEY ?= "${SECURE_BASE}/conf/keys/swu_aes256_key.bin"
```
